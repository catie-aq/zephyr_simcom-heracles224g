## drivers/modem/Kconfig
```kconfig
# Copyright (c) 2025 CATIE
# SPDX-License-Identifier: Apache-2.0

menuconfig MODEM_SIMCOM_HERACLES224G
	bool "SIMCom Heracles 224G cellular modem driver"
	default y
	depends on DT_HAS_SIMCOM_HERACLES224G_ENABLED
	depends on MODEM_CELLULAR
	select MODEM_CMUX_DEFAULT_MTU_127
	help
	  Enable the SIMCom Heracles 224G (GSM / LTE Cat-M1 / NB-IoT) modem
	  driver. It is built on top of the Zephyr generic cellular modem
	  framework (CMUX + PPP), so the modem exposes a native Zephyr network
	  interface.

if MODEM_SIMCOM_HERACLES224G

choice MODEM_SIMCOM_HERACLES224G_NETWORK_MODE
	prompt "Preferred network mode (AT+CNMP)"
	default MODEM_SIMCOM_HERACLES224G_NETWORK_MODE_UNCHANGED
	help
	  Network mode configured at modem initialization. The value is saved
	  by the modem in non-volatile memory.

config MODEM_SIMCOM_HERACLES224G_NETWORK_MODE_UNCHANGED
	bool "Keep the modem setting"
	help
	  AT+CNMP is not sent: the modem uses its saved (or factory) setting.

config MODEM_SIMCOM_HERACLES224G_NETWORK_MODE_AUTO
	bool "Automatic (AT+CNMP=2)"

config MODEM_SIMCOM_HERACLES224G_NETWORK_MODE_GSM
	bool "GSM only (AT+CNMP=13)"

config MODEM_SIMCOM_HERACLES224G_NETWORK_MODE_LTE
	bool "LTE only (AT+CNMP=38)"

config MODEM_SIMCOM_HERACLES224G_NETWORK_MODE_GSM_LTE
	bool "GSM and LTE (AT+CNMP=51)"

endchoice

config MODEM_SIMCOM_HERACLES224G_SET_NETWORK_MODE
	bool
	default y if !MODEM_SIMCOM_HERACLES224G_NETWORK_MODE_UNCHANGED

config MODEM_SIMCOM_HERACLES224G_CNMP_VALUE
	int
	default 2 if MODEM_SIMCOM_HERACLES224G_NETWORK_MODE_AUTO
	default 13 if MODEM_SIMCOM_HERACLES224G_NETWORK_MODE_GSM
	default 38 if MODEM_SIMCOM_HERACLES224G_NETWORK_MODE_LTE
	default 51 if MODEM_SIMCOM_HERACLES224G_NETWORK_MODE_GSM_LTE
	default 0

choice MODEM_SIMCOM_HERACLES224G_LTE_TECH
	prompt "Preferred LTE technology (AT+CMNB)"
	default MODEM_SIMCOM_HERACLES224G_LTE_TECH_UNCHANGED
	help
	  LTE technology configured at modem initialization. The value is
	  saved by the modem in non-volatile memory.

config MODEM_SIMCOM_HERACLES224G_LTE_TECH_UNCHANGED
	bool "Keep the modem setting"
	help
	  AT+CMNB is not sent: the modem uses its saved (or factory) setting.

config MODEM_SIMCOM_HERACLES224G_LTE_TECH_CATM
	bool "LTE Cat-M1 (AT+CMNB=1)"

config MODEM_SIMCOM_HERACLES224G_LTE_TECH_NBIOT
	bool "NB-IoT (AT+CMNB=2)"

config MODEM_SIMCOM_HERACLES224G_LTE_TECH_CATM_NBIOT
	bool "LTE Cat-M1 and NB-IoT (AT+CMNB=3)"

endchoice

config MODEM_SIMCOM_HERACLES224G_SET_LTE_TECH
	bool
	default y if !MODEM_SIMCOM_HERACLES224G_LTE_TECH_UNCHANGED

config MODEM_SIMCOM_HERACLES224G_CMNB_VALUE
	int
	default 1 if MODEM_SIMCOM_HERACLES224G_LTE_TECH_CATM
	default 2 if MODEM_SIMCOM_HERACLES224G_LTE_TECH_NBIOT
	default 3 if MODEM_SIMCOM_HERACLES224G_LTE_TECH_CATM_NBIOT
	default 0

endif # MODEM_SIMCOM_HERACLES224G
```

## drivers/modem/simcom/heracles224g/Kconfig
```kconfig
# Copyright (c) 2025 CATIE
# SPDX-License-Identifier: Apache-2.0

config MODEM_HERACLES224G
	bool "Heracles224g Driver"
	select MODEM_CONTEXT
	select MODEM_CMD_HANDLER
	select MODEM_IFACE_UART
	select MODEM_SOCKET
	select NET_OFFLOAD
	select NET_SOCKETS_OFFLOAD
	imply GPIO
	help
	  Enables the driver for the Heracles224g modem.

if MODEM_HERACLES224G

config MODEM_SIMCOM_HERACLES224G_RX_STACK_SIZE
	int "Stack size for the simcom heracles224g modem driver rx thread"
	default 1028
	help
	  This stack is used by the simcom HERACLES224G RX thread.

config MODEM_SIMCOM_HERACLES224G_RX_WORKQ_STACK_SIZE
	int "Stack size for the simcom heracles224g modem driver work queue"
	default 2048
	help
		This stack is used by the work queue.

config MODEM_SIMCOM_HERACLES224G_INIT_PRIORITY
	int "simcom heracles224g driver init priority"
	default 80
	help
	  simcom heracles224g driver initialization priority.

config MODEM_SIMCOM_HERACLES224G_LTE_BANDS
	string "LTE bands the driver can use"
	default "8,20,28"
	help
		Comma separated list of usable lte bands.

config MODEM_SIMCOM_HERACLES224G_APN
	string "APN for establishing a network connection"
	default "internet"
	help
	  This setting is used to set the APN name for the network connection
	  context. This value is specific to the network provider and may
	  need to be changed.

choice MODEM_SIMCOM_HERACLES224G_RAT
	bool "Radio Access Technology Mode"
	default MODEM_SIMCOM_HERACLES224G_RAT_M1

config MODEM_SIMCOM_HERACLES224G_RAT_NB1
	bool "NB-IoT"
	help
		Enable LTE NB-IoT mode.

config MODEM_SIMCOM_HERACLES224G_RAT_M1
	bool "Cat-M1"
	help
		Enable Cat-M1 mode.

config MODEM_SIMCOM_HERACLES224G_RAT_GSM
	bool "GSM"
	help
	  Enable GSM mode.

endchoice

endif # MODEM_HERACLES224G
```

## dts/bindings/modem/simcom,heracles224g.yaml
```yaml
# Copyright (c) 2025 CATIE
# SPDX-License-Identifier: Apache-2.0

description: |
  SIMCom Heracles 224G GSM / LTE Cat-M1 / NB-IoT modem

  The modem is driven through the Zephyr generic cellular modem framework
  (CMUX + PPP).

compatible: "simcom,heracles224g"

include: zephyr,cellular-modem-device.yaml

properties:
  mdm-power-gpios:
    type: phandle-array
    required: true
    description: |
      GPIO driving the modem PWRKEY. The logical active level must pull
      PWRKEY low (power-on pulse > 1 s, power-off pulse > 1.5 s).
```
