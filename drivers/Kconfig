## drivers/Kconfig
```kconfig
# Copyright (c) 2025 CATIE
# SPDX-License-Identifier: Apache-2.0

menu "Device Drivers"

rsource "modem/Kconfig"

endmenu
```

## drivers/modem/simcom/Kconfig
```kconfig
# Copyright (c) 2025 CATIE
# SPDX-License-Identifier: Apache-2.0

rsource "heracles224g/Kconfig"
```

## drivers/sensor/Kconfig
```kconfig
# Copyright (c) 2025 CATIE
# SPDX-License-Identifier: Apache-2.0

if SENSOR

rsource "simcom/Kconfig"

endif # SENSOR
```

## dts/bindings/sensor/simcom,heracles224g.yaml
```yaml
# Copyright (c) 2025 CATIE
# SPDX-License-Identifier: Apache-2.0

description: |
    SIMCom Heracles 224G LTE-M driver for Zephyr OS.

compatible: "simcom,heracles224g"

include: [sensor-device.yaml]
```
